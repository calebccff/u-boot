## arch/arm/mach-snapdragon/Kconfig
```kconfig
if ARCH_SNAPDRAGON

config SYS_SOC
	default "snapdragon"

config SYS_MALLOC_F_LEN
	default 0x2000

config SPL_SYS_MALLOC_F_LEN
	default 0x2000

config SDM845
	bool "Qualcomm Snapdragon 845 SoC"
	default n
	select LINUX_KERNEL_IMAGE_HEADER
	select REGMAP

config LNX_KRNL_IMG_TEXT_OFFSET_BASE
	default 0x80000000

choice
	prompt "Snapdragon board select"

config TARGET_SDM845
	bool "SDM845 common target"
	help
	  Support for boards based on Qualcomm Snapdragon 845 SoC.
	  Supported devices and associated DEFAULT_DEVICE_TREE:
	    * Robotics RB3 Development Platform ("db845c")
	    * phones with 8GB ram ("sdm845-phone-8gb")
	    * TODO: phones with 6GB ram ("sdm845-phone-6gb")
	    * phones with 4GB ram ("sdm845-phone-4gb")
	select MISC_INIT_R
	select SDM845

config TARGET_DRAGONBOARD410C
	bool "96Boards Dragonboard 410C"
	select BOARD_LATE_INIT
	select ENABLE_ARM_SOC_BOOT0_HOOK
	select REGMAP
	help
	  Support for 96Boards Dragonboard 410C. This board complies with
	  96Board Open Platform Specifications. Features:
	  - Qualcomm Snapdragon 410C SoC - APQ8016 (4xCortex A53, Adreno 306)
	  - 1GiB RAM
	  - 8GiB eMMC, uSD slot
	  - WiFi, Bluetooth and GPS module
	  - 2x Host, 1x Device USB port
	  - HDMI
	  - 20-pin low speed and 40-pin high speed expanders, 4 LED, 3 buttons

config TARGET_DRAGONBOARD820C
	bool "96Boards Dragonboard 820C"
	select REGMAP
	help
	  Support for 96Boards Dragonboard 820C. This board complies with
	  96Board Open Platform Specifications. Features:
	  - Qualcomm Snapdragon 820C SoC - APQ8096 (4xKyro CPU)
	  - 3GiB RAM
	  - 32GiB UFS drive

config TARGET_DRAGONBOARD845C
	bool "96Boards Dragonboard 845C"
	help
	  Support for 96Boards Dragonboard 845C aka Robotics RB3 Development
	  Platform. This board complies with 96Boards Open Platform
	  Specifications. Features:
	  - Qualcomm Snapdragon SDA845 SoC
	  - 4GiB RAM
	  - 64GiB UFS drive
	select MISC_INIT_R
	select SDM845

config TARGET_STARQLTECHN
	bool "Samsung S9 SM-G9600(starqltechn)"
	help
	  Support for Samsung S9 SM-G9600(starqltechn) board.
	  Features:
	  - Qualcomm Snapdragon SDM845 SoC
	  - 4GiB RAM
	  - 64GiB UFS drive
	select MISC_INIT_R
	select SDM845

config TARGET_QCS404EVB
	bool "Qualcomm Technologies, Inc. QCS404 EVB"
	select LINUX_KERNEL_IMAGE_HEADER
	select REGMAP
	help
	  Support for Qualcomm Technologies, Inc. QCS404 evaluation board.
	  Features:
	  - Qualcomm Snapdragon QCS404 SoC
	  - 1GiB RAM
	  - 8GiB eMMC, uSD slot

config TARGET_QRB4210RB2
	bool "Qualcomm Technologies, Inc. QRB4210 RB2"
	select LINUX_KERNEL_IMAGE_HEADER
	select REGMAP
	help
	  Support for Qualcomm Technologies, Inc. QRB4210 RB2 board.
	  Features:
	  - Qualcomm Snapdragon SM6115 / SM4250 SoC
	  - 2GiB RAM
	  - 16GiB eMMC

config TARGET_QRB5165RB5
	bool "Qualcomm Technologies, Inc. QRB5165 RB5"
	select LINUX_KERNEL_IMAGE_HEADER
	select SYS_HAS_NONCACHED_MEMORY
	select REMOTEPROC_QCOM_RPMH_RSC
	select REGMAP
	help
	  Support for Qualcomm Technologies, Inc. QRB5165 RB5 board.
	  Features:
	  - Qualcomm Snapdragon SM8250 SoC
	  - 2GiB RAM
	  - 16GiB eMMC

endchoice

source "board/qualcomm/dragonboard410c/Kconfig"
source "board/qualcomm/dragonboard820c/Kconfig"
source "board/qualcomm/dragonboard845c/Kconfig"
source "board/qualcomm/sdm845/Kconfig"
source "board/samsung/starqltechn/Kconfig"
source "board/qualcomm/qcs404-evb/Kconfig"
source "board/qualcomm/qrb4210-rb2/Kconfig"
source "board/qualcomm/qrb5165-rb5/Kconfig"

endif
```

## board/qualcomm/sdm845/Kconfig
```kconfig
if TARGET_SDM845

config SYS_BOARD
	default "sdm845"

config SYS_CONFIG_NAME
	default "sdm845"

config SYS_VENDOR
	default "qualcomm"

endif
```

## configs/axolotl_defconfig
```kconfig
CONFIG_ARM=y
CONFIG_SKIP_LOWLEVEL_INIT=y
CONFIG_COUNTER_FREQUENCY=19000000
CONFIG_POSITION_INDEPENDENT=y
CONFIG_ARCH_SNAPDRAGON=y
CONFIG_DEFAULT_DEVICE_TREE="axolotl"
CONFIG_TARGET_STARQLTECHN=y
CONFIG_IDENT_STRING="\nSHIFT6mq"
CONFIG_SYS_LOAD_ADDR=0x80000000
CONFIG_FIT=y
CONFIG_FIT_VERBOSE=y
CONFIG_BOOTDELAY=0
CONFIG_SAVE_PREV_BL_FDT_ADDR=y
CONFIG_SAVE_PREV_BL_INITRAMFS_START_ADDR=y
# CONFIG_DISPLAY_CPUINFO is not set
CONFIG_HUSH_PARSER=y
CONFIG_SYS_MAXARGS=64
CONFIG_SYS_CBSIZE=512
CONFIG_SYS_PBSIZE=532
CONFIG_CMD_BOOTDEV=y
CONFIG_CMD_BOOTMETH=y
CONFIG_CMD_BOOTMENU=y
CONFIG_CMD_CAT=y
CONFIG_CMD_GPIO=y
CONFIG_CMD_BMP=y
CONFIG_CMD_GPT=y
CONFIG_CMD_LOG=y
CONFIG_CMD_MMC=y
CONFIG_CMD_PART=y
CONFIG_CMD_REMOTEPROC=y
CONFIG_CMD_UFS=y
CONFIG_CMD_USB=y
CONFIG_CMD_EXT2=y
CONFIG_CMD_EXT4=y
CONFIG_CMD_EXT4_WRITE=y
CONFIG_CMD_FAT=y
CONFIG_CMD_FS_GENERIC=y
CONFIG_CMD_SYSBOOT=y
# CONFIG_NET is not set
CONFIG_CLK=y
CONFIG_MSM_GPIO=y
CONFIG_QCOM_PMIC_GPIO=y
CONFIG_MISC=y
CONFIG_MMC_HS400_ES_SUPPORT=y
CONFIG_MMC_HS400_SUPPORT=y
CONFIG_MMC_SDHCI=y
CONFIG_MMC_SDHCI_ADMA=y
CONFIG_MMC_SDHCI_MSM=y
CONFIG_PHY=y
CONFIG_PHY_QCOM_QMP_UFS=y
CONFIG_PHY_QCOM_QMP_USB=y
CONFIG_PHY_QCOM_USB_HS_28NM=y
CONFIG_PHY_QCOM_USB_SS=y
CONFIG_PINCTRL=y
CONFIG_DM_PMIC=y
CONFIG_PMIC_QCOM=y
CONFIG_SCSI=y
CONFIG_UFS=y
CONFIG_QCOM_UFS=y
CONFIG_MSM_GENI_SERIAL=y
CONFIG_SPMI_MSM=y
CONFIG_VIDEO=y
CONFIG_SYS_WHITE_ON_BLACK=y
CONFIG_VIDEO_SIMPLE=y
CONFIG_VIDEO_DT_SIMPLEFB=y
CONFIG_LMB_MAX_REGIONS=64
CONFIG_BAUDRATE=3000000
# Necessary to load initramfs directly from boot partition
CONFIG_SUPPORT_RAW_INITRD=y
# Used for scsi_scan etc...
CONFIG_USE_PREBOOT=y
CONFIG_CMD_EFIDEBUG=y
# Maybe needed for UFS buffers?
# CONFIG_SYS_HAS_NONCACHED_MEMORY=y

# Caleb debug stuff
CONFIG_LOG=y
CONFIG_LOG_MAX_LEVEL=9
CONFIG_LOG_DEFAULT_LEVEL=6
CONFIG_LOGF_FUNC=y

# TODO: look into
# CONFIG_ENV_IS_IN_EXT4
# and associated options (hardcode a partition)
```
